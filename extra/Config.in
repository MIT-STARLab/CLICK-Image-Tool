## extra/Config.in
```kconfig
source "$BR2_EXTERNAL_CLICK_PATH/package/click-fsw/Config.in"
source "$BR2_EXTERNAL_CLICK_PATH/package/click-fpga/Config.in"
source "$BR2_EXTERNAL_CLICK_PATH/package/matrix-vision/Config.in"
source "$BR2_EXTERNAL_CLICK_PATH/package/png2jpeg/Config.in"
source "$BR2_EXTERNAL_CLICK_PATH/package/python-crccheck/Config.in"
```

## extra/package/click-fsw/Config.in
```kconfig
config BR2_PACKAGE_CLICK_FSW
    bool "click-fsw"
    depends on BR2_LINUX_KERNEL
    select BR2_PACKAGE_LIBUSB
    select BR2_PACKAGE_ZEROMQ
    select BR2_PACKAGE_CPPZMQ
    select BR2_PACKAGE_MATRIX_VISION
    select BR2_PACKAGE_NLOPT
    select BR2_PACKAGE_PYTHON
    select BR2_PACKAGE_PYTHON_PYZMQ
    select BR2_PACKAGE_PYTHON_CRCCHECK
    select BR2_PACKAGE_PYTHON_SPIDEV
    select BR2_PACKAGE_PYTHON_HASHLIB
    select BR2_PACKAGE_PYTHON_PSUTIL
    select BR2_PACKAGE_PYTHON_ZLIB
```

## extra/package/driver/Config.in
```kconfig
config BR2_PACKAGE_CLICK_DRIVER
    bool "driver"
    depends on BR2_LINUX_KERNEL
```

## extra/package/fpgalink/Config.in
```kconfig
config BR2_PACKAGE_FPGALINK
    bool "fpgalink"

    help
        A library for JTAG-programming and subsequently interacting with an FPGA over USB using a microcontroller (primarily the Cypress FX2LP).

        https://github.com/makestuff/libfpgalink
```

## extra/package/matrix-vision/Config.in
```kconfig
config BR2_PACKAGE_MATRIX_VISION
    bool "matrix-vision"
    depends on BR2_GCC_ENABLE_OPENMP
    select BR2_PACKAGE_LIBUSB
    select BR2_PACKAGE_EXPAT

    help
        Matrix Vision libraries for the mvBlueFox camera.

        http://static.matrix-vision.com/mvIMPACT_Acquire/
```

## extra/package/png2jpeg/Config.in
```kconfig
config BR2_PACKAGE_PNG2JPEG
    bool "png2jpeg"
    select BR2_PACKAGE_ZLIB
    select BR2_PACKAGE_JPEG
    select BR2_PACKAGE_LIBPNG
  
    help
        png2jpeg is a simple command-line image converter from PNG to JPEG.

        https://sourceforge.net/projects/png2jpeg/
```

## extra/package/python-crccheck/Config.in
```kconfig
config BR2_PACKAGE_PYTHON_CRCCHECK
	bool "python-crccheck"
	help
	  Calculation library for CRCs and checksums.

	  https://sourceforge.net/projects/crccheck/
```
